## app/boards/shields/mdactyl/Kconfig.shield
```kconfig
config SHIELD_MDACTYL_LEFT
    def_bool $(shields_list_contains,mdactyl_left)

config SHIELD_MDACTYL_RIGHT
    def_bool $(shields_list_contains,mdactyl_right)
```

## config/boards/shields/mdactyl/Kconfig.defconfig
```kconfig
if SHIELD_MDACTYL_LEFT

config ZMK_KEYBOARD_NAME
    default "MKBLL"


config ZMK_SPLIT_BLE_ROLE_CENTRAL
    default y

endif

if SHIELD_MDACTYL_RIGHT

config ZMK_KEYBOARD_NAME
    default "MKBR"

endif

if SHIELD_MDACTYL_LEFT || SHIELD_MDACTYL_RIGHT

config ZMK_SPLIT
    default y

endif
```
